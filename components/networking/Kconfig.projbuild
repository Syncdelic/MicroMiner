## components/networking/Kconfig.projbuild
```kconfig
menu "Pool configuration"

	config POOL_ADDRESS
		string "Pool Address"
        default ""
		help
            Make sure your pool supports the implemented protocol.

    config POOL_PORT
        int "Pool Port"
        range 1 9999
        default 3333
        help
            The port where your pool has setup for mining operations.
    config WALLET
        string "Wallet"
        default ""
        help
            The wallet ID of the coin your mining.
endmenu
```

## components/wifi/Kconfig.projbuild
```kconfig
menu "Wi-Fi configuration"

	config WIFI_SSID
		string "WiFi SSID"
        default ""
		help
            The SSID of your Wifi connection.

    config WIFI_PASSWORD
        string "WiFi Password"
        default ""
        help
            The password of your Wifi connection.
endmenu
```
